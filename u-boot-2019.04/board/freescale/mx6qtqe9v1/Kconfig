## u-boot-2019.04/board/freescale/mx6qtqe9v1/Kconfig
```kconfig
if TARGET_MX6QTQE9V1

config SYS_BOARD
	default "mx6qtqe9v1"

config SYS_VENDOR
	default "freescale"

config SYS_CONFIG_NAME
	default "mx6qtqe9v1"

endif
```
